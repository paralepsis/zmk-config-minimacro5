#include <behaviors.dtsi>
#include <dt-bindings/zmk/keys.h>
#include <dt-bindings/zmk/bt.h>
#include <dt-bindings/zmk/outputs.h>

/ {
    keymap {
        compatible = "zmk,keymap";

        default_layer {
            bindings = <
                &kp A &kp TAB  &kp F2  &kp G &kp ESC
            >;
            sensor-bindings = <&inc_dec_kp PG_UP PG_DN>;
        };
    };
};

